## sdkconfig.defaults
```kconfig
# GustavClock2 sdkconfig defaults.
# Apply with: idf.py reconfigure (first build picks them up automatically).

# --- Target ------------------------------------------------------------------
CONFIG_IDF_TARGET="esp32"

# --- Flash size --------------------------------------------------------------
CONFIG_ESPTOOLPY_FLASHSIZE_4MB=y

# --- Main task stack ---------------------------------------------------------
CONFIG_ESP_MAIN_TASK_STACK_SIZE=8192

# --- Partition table ---------------------------------------------------------
CONFIG_PARTITION_TABLE_CUSTOM=y
CONFIG_PARTITION_TABLE_CUSTOM_FILENAME="partitions/partitions.csv"

# --- WiFi --------------------------------------------------------------------
CONFIG_ESP_WIFI_STATIC_RX_BUFFER_NUM=10
CONFIG_ESP_WIFI_DYNAMIC_RX_BUFFER_NUM=32

# --- HTTP server -------------------------------------------------------------
CONFIG_HTTPD_MAX_URI_LEN=1024
CONFIG_HTTPD_MAX_REQ_HDR_LEN=1024

# --- SNTP --------------------------------------------------------------------
CONFIG_LWIP_SNTP_MAX_SERVERS=3

# --- FreeRTOS tick rate ------------------------------------------------------
CONFIG_FREERTOS_HZ=1000

# --- FreeRTOS stack overflow detection ---------------------------------------
CONFIG_FREERTOS_CHECK_STACKOVERFLOW_CANARY=y
CONFIG_FREERTOS_WATCHPOINT_END_OF_STACK=y

# --- IPC task stack ----------------------------------------------------------
CONFIG_ESP_IPC_TASK_STACK_SIZE=4096

# --- Per-core ISR stack ------------------------------------------------------
CONFIG_FREERTOS_ISR_STACKSIZE=4096

# --- FreeRTOS task trace / watermark logging ---------------------------------
CONFIG_FREERTOS_USE_TRACE_FACILITY=y
CONFIG_FREERTOS_USE_STATS_FORMATTING_FUNCTIONS=y

# --- Idle task stack ---------------------------------------------------------
CONFIG_FREERTOS_IDLE_TASK_STACKSIZE=4096

# --- C++ ---------------------------------------------------------------------
CONFIG_COMPILER_CXX_EXCEPTIONS=n
CONFIG_COMPILER_CXX_RTTI=n
```
